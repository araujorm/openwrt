// SPDX-License-Identifier: GPL-2.0-or-later OR MIT

#include "mt7628an_joowin_jw-wr758ac.dts"

/ {
	compatible = "joowin,jw-wr758ac,v2", "joowin,jw-wr758ac", "mediatek,mt7628an-soc";
	model = "Joowin WR758AC V2";
};
